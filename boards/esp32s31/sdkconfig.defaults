## boards/osptek_p4c5/sdkconfig.defaults
```kconfig
# OSPTEK P4C5 with the bundled YDP430BT009 panel.
CONFIG_ESP32P4_REV_MIN_301=y
CONFIG_SPIRAM_SPEED_250M=y
CONFIG_GPSP_LCD=y
CONFIG_GPSP_AUDIO=y
CONFIG_GPSP_AUDIO_HIGHPASS=y
CONFIG_GPSP_USB_PAD=y
CONFIG_GPSP_USB_BT=y
CONFIG_GPSP_USB_PAD_DIAGNOSTICS=y
# CONFIG_GPSP_PERFORMANCE_DIAGNOSTICS is not set
CONFIG_SLAVE_IDF_TARGET_ESP32C5=y
CONFIG_ESP_HOSTED_SDIO_HOST_INTERFACE=y
CONFIG_ESP_HOSTED_SDIO_SLOT_1=y
CONFIG_ESP_HOSTED_SDIO_4_BIT_BUS=y
CONFIG_ESP_HOSTED_SDIO_CLOCK_FREQ_KHZ=40000
CONFIG_ESP_HOSTED_PRIV_SDIO_PIN_CMD_SLOT_1=19
CONFIG_ESP_HOSTED_PRIV_SDIO_PIN_CLK_SLOT_1=18
CONFIG_ESP_HOSTED_PRIV_SDIO_PIN_D0_SLOT_1=14
CONFIG_ESP_HOSTED_PRIV_SDIO_PIN_D1_4BIT_BUS_SLOT_1=15
CONFIG_ESP_HOSTED_PRIV_SDIO_PIN_D2_4BIT_BUS_SLOT_1=16
CONFIG_ESP_HOSTED_PRIV_SDIO_PIN_D3_4BIT_BUS_SLOT_1=17
CONFIG_ESP_HOSTED_SDIO_GPIO_RESET_SLAVE=54
CONFIG_WIFI_RMT_DYNAMIC_TX_BUFFER_NUM=64
CONFIG_WIFI_RMT_TX_BA_WIN=32
CONFIG_WIFI_RMT_RX_BA_WIN=16
CONFIG_LWIP_TCP_SND_BUF_DEFAULT=41760
CONFIG_LWIP_TCP_WND_DEFAULT=65535
CONFIG_LWIP_TCP_RECVMBOX_SIZE=48
CONFIG_LWIP_UDP_RECVMBOX_SIZE=48
CONFIG_LWIP_TCPIP_RECVMBOX_SIZE=48
CONFIG_LWIP_TCP_SACK_OUT=y
CONFIG_GPSP_SERVER_HOST=""
CONFIG_GPSP_WIFI_SSID=""
CONFIG_GPSP_WIFI_PASSWORD=""
# A 256 KiB L2 cache runs JIT code and PSRAM data much faster than 128 KiB.
# Use 128 KiB if internal SRAM runs short.
CONFIG_CACHE_L2_CACHE_256KB=y

CONFIG_GPSP_LCD_DSI=y
CONFIG_GPSP_LCD_DSI_OSPTEK=y
CONFIG_GPSP_LCD_DSI_DMA_EXPAND=y
CONFIG_GPSP_LCD_DSI_TILE_8=y
CONFIG_GPSP_LCD_DSI_CPU_ROTATE=y
CONFIG_GPSP_SD_LDO_CHAN=-1
```

## components/gpsp/Kconfig
```kconfig
# Copyright (C) 2026 Midworld Kim
# SPDX-License-Identifier: GPL-3.0-or-later

menu "gpSP core"

    config GPSP_AFFINE_PIE
        bool "PIE affine renderer acceleration"
        depends on SOC_CPU_HAS_PIE && !ESPEMU
        depends on !IDF_TARGET_ESP32S31 || !FREERTOS_UNICORE
        default y if IDF_TARGET_ESP32P4
        default n
        help
            Use XespV instructions for affine rendering. Disabled builds
            use the scalar renderer. ESP32-S31 requires CPU1 affinity and
            defaults to disabled.

    config GPSP_ROM_BUFFER_SIZE
        int "Maximum ROM buffer size (MiB, 0 = auto)"
        range 0 32
        default 0
        help
            0 selects 4 MiB with up to 16 MiB PSRAM, or 8 MiB with more.
            Nonzero values set a fixed maximum in 1 MiB blocks. Allocation
            stops early if there is not enough memory. After a ROM is opened,
            only the blocks it needs are kept. Larger ROMs load 32 KiB pages
            from the file as needed.

    config GPSP_RV32_CODE_CHUNK_KIB
        int "RV32 code cache chunk size (KiB)"
        range 64 2048
        default 256
        help
            Each code cache starts with one chunk and adds a chunk when
            the current one is full. Use a power of two that divides the
            ROM and RAM cache limits.

    config GPSP_RV32_ROM_CACHE_KIB
        int "RV32 ROM code cache limit (KiB)"
        range 64 2048
        default 2048
        help
            Largest size of the executable ROM translation cache. It is
            allocated from executable PSRAM. A full cache at this size
            is flushed.

    config GPSP_RV32_RAM_CACHE_KIB
        int "RV32 RAM code cache limit (KiB)"
        range 64 4096
        default 2048
        help
            Largest size of the executable cache for code run from EWRAM
            and IWRAM. A full cache at this size flushes both code caches.
            Some games need more than 1 MiB.

endmenu
```
