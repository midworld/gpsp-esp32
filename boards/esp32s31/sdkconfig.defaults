## main/Kconfig.projbuild
```kconfig
config GPSP_BOARD_NAME
    string
    default "$(GPSP_BUILD_BOARD)"

# Copyright (C) 2026 Midworld Kim
# SPDX-License-Identifier: GPL-3.0-or-later

menu "gpSP transport"

    config ESPEMU
        bool "Use ESP-EMU backend"
        default n
        help
            Use virtual Ethernet and the ESP-EMU host address.

    config GPSP_BENCHMARK
        bool "Emit fixed-frame benchmark results"
        default n
        help
            Measure 64-frame windows from the first retro_run().
            Wait for the host receiver before running the first frame.
            Emit frame and detail records after the configured frame count.
            Without STOP_AFTER_REPORT, keep reporting 64-frame windows.

    config GPSP_BENCHMARK_STOP_AFTER_REPORT
        bool "Stop after benchmark results"
        depends on GPSP_BENCHMARK
        default n
        help
            Stop the game and emit BENCH_DONE after the configured report.
            Leave disabled to keep playing and reporting detail windows.

    config GPSP_BENCHMARK_FRESH_SAVE
        bool "Ignore cartridge saves during benchmark runs"
        depends on GPSP_BENCHMARK
        default n
        help
            Start with untouched cartridge save RAM and skip save writes.
            Existing save files remain available for normal builds.

    config GPSP_CARTRIDGE_AUTOSAVE
        bool "Automatically load and write cartridge save RAM"
        default n
        help
            Load cartridge save RAM at startup and write changes during play.
            Leave disabled to use only manual full-state save and load.

    config GPSP_BENCHMARK_FRAMES
        int "Benchmark frame count"
        depends on GPSP_BENCHMARK
        range 64 5120
        default 5120
        help
            Emit 64-frame windows. The last window may be shorter.

    config GPSP_BENCHMARK_CAPTURE_STATE_FRAME
        int "Save full state after benchmark frame (0 disables)"
        depends on GPSP_BENCHMARK
        range 0 GPSP_BENCHMARK_FRAMES
        default 0
        help
            Save a full state after the selected frame for repeat benchmarks.

    config GPSP_BENCHMARK_LOAD_STATE
        bool "Load full state before benchmark frames"
        depends on GPSP_BENCHMARK
        default n
        help
            Load the ROM's full state file before the first measured frame.

    config GPSP_BENCHMARK_HOLD_BUTTONS
        hex "Buttons held during benchmark frames"
        depends on GPSP_BENCHMARK
        range 0x0 0xffff
        default 0x0
        help
            RetroPad button mask held on every frame, e.g. 0x40 for left.

    config GPSP_BENCHMARK_JIT_DETAIL
        bool "Measure RV32 JIT block internals"
        depends on GPSP_BENCHMARK
        default y
        help
            Count RAM fast paths and time generated code and C helper bridges.
            This adds work to every measured JIT call.

    config GPSP_BENCHMARK_JIT_LOOKUP
        bool "Measure RV32 JIT lookup and translation"
        depends on GPSP_BENCHMARK
        default y
        help
            Split lookup hits, misses, translation time, and cache flushes.
            This adds work to every measured block lookup.

    config GPSP_BENCHMARK_JIT_MISS_CLASS
        bool "Classify RV32 JIT lookup misses"
        depends on GPSP_BENCHMARK_JIT_LOOKUP
        default y
        help
            Count repeated entry PCs and PCs inside prior translated blocks.
            This keeps a block-range table and slows translation misses.

    config GPSP_BENCHMARK_JIT_CODE_BYTES
        bool "Count generated RV32 code bytes by purpose"
        depends on GPSP_BENCHMARK_JIT_MISS_CLASS
        default y
        help
            Count emitted guards, instruction bodies, timing, batch paths,
            exits, and overlapping translations. Disabled builds omit the
            counters.

    config GPSP_BENCHMARK_PHASE_WORK
        bool "Count timer, DMA, and sound work per frame"
        depends on GPSP_BENCHMARK
        default y
        help
            Count phase entries, requested DMA bytes, and generated sound
            samples. This adds work to diagnostic benchmark runs.

    config GPSP_BENCHMARK_VIDEO_DETAIL
        bool "Measure GBA scanline stages"
        depends on GPSP_BENCHMARK
        default y
        help
            Time scanline setup and drawing by stage. This adds work to every
            visible scanline and can change benchmark frame times.

    config GPSP_BENCHMARK_INSTRET
        bool "Count retired instructions per core phase"
        depends on GPSP_BENCHMARK && IDF_TARGET_ARCH_RISCV
        default n
        help
            Read the minstret CSR at each phase change. Use it where the CSR
            exists, such as ESP-EMU, to compare generated code by executed
            instruction count.

    config GPSP_ESPEMU_UNTHROTTLED
        bool "Run the core without guest-time frame pacing"
        default n
        help
            Run retro_run() continuously for performance measurements.
            Gameplay timing is not preserved in this mode. The frontend
            still yields one FreeRTOS tick every 60 frames for watchdog
            housekeeping.

    config GPSP_ESPEMU_HOST
        string "Host viewer IPv4 address"
        depends on ESPEMU
        default "192.168.4.1"
        help
            Address used by the ESP-EMU user network to reach the host.

    config GPSP_ESPEMU_PORT
        int "Host viewer TCP port"
        depends on ESPEMU
        range 1024 65535
        default 24680

endmenu

menu "gpSP physical network"
    depends on IDF_TARGET_ESP32P4 && !ESPEMU

    config GPSP_SERVER_HOST
        string "Frame receiver IPv4 address"
        default ""
        help
            Leave empty to disable frame transmission.

    config GPSP_SERVER_PORT
        int "Frame receiver TCP port"
        range 1024 65535
        default 24680

    config GPSP_WIFI_SSID
        string "Wi-Fi SSID"
        default ""

    config GPSP_WIFI_PASSWORD
        string "Wi-Fi password"
        default ""

    config GPSP_WIFI_PREFER_5GHZ
        bool "Prefer 5 GHz Wi-Fi"
        depends on SLAVE_SOC_WIFI_SUPPORT_5G
        default y
        help
            Scan all channels and pick a 5 GHz access point for the
            configured SSID unless it is much weaker than a 2.4 GHz one.

    config GPSP_WIFI_5GHZ_RSSI_BONUS
        int "5 GHz RSSI bonus (dB)"
        depends on GPSP_WIFI_PREFER_5GHZ
        range 0 60
        default 20
        help
            A 5 GHz access point wins while its RSSI is within this many dB
            of the best 2.4 GHz one.

endmenu

menu "gpSP SD card"
    depends on IDF_TARGET_ESP32P4 || ESPEMU

    config GPSP_SD_CARD
        bool "Load ROMs from the SD card"
        default y if !ESPEMU
        help
            Mount the SD card (SDMMC slot 0) at boot. With a card, the ROM
            is chosen in this order: a file name sent over the console
            within the wait time, "rom=<name>" in /sdcard/gpsp.cfg, then
            the ROM in the storage partition. ESP-EMU uses the "sdcard"
            flash partition as the card.

    config GPSP_SD_ROM_WAIT_MS
        int "Console wait for a ROM name (ms)"
        depends on GPSP_SD_CARD
        range 0 10000
        default 2000

    config GPSP_SD_LDO_CHAN
        int "On-chip LDO channel for SD power (-1 for none)"
        depends on GPSP_SD_CARD && !ESPEMU
        range -1 4
        default 4

endmenu

menu "gpSP LCD"
    depends on IDF_TARGET_ESP32P4 && !ESPEMU

    config GPSP_LCD
        bool "Show the game on an LCD"
        default n
        help
            Select the connected display.

    choice GPSP_LCD_TYPE
        prompt "Display type"
        depends on GPSP_LCD
        default GPSP_LCD_SPI

        config GPSP_LCD_SPI
            bool "SPI ST7789 (320x240)"
            help
                SPI2: SCLK=20, MOSI=21, CS=5, DC=26, RST=25, BL=32.
                The game and UI are drawn 1:1 in the center.

        config GPSP_LCD_DSI
            bool "MIPI DSI (480x800)"
            help
                Two-lane MIPI DSI. Panel control depends on the selected model.
                Landscape output: games 3x, UI 2x nearest.
                The menu selects nearest, PPA bilinear, or an LCD grid,
                with a separate color profile. Touch input is not enabled.
    endchoice

    choice GPSP_LCD_DSI_MODEL
        prompt "DSI panel"
        depends on GPSP_LCD_DSI
        default GPSP_LCD_DSI_4_3

        config GPSP_LCD_DSI_4
            bool "4-DSI-TOUCH-A"

        config GPSP_LCD_DSI_4_3
            bool "4.3-DSI-TOUCH-A"
        config GPSP_LCD_DSI_OSPTEK
            bool "OSPTEK YDP430BT009 (ST7102)"
    endchoice

    config GPSP_LCD_DSI_SIMD
        bool "Use PIE SIMD for DSI integer scaling"
        depends on GPSP_LCD_DSI
        default y
        help
            Expand eight RGB565 pixels at a time for nearest and LCD grid.
            Bilinear stays on PPA. Disable for emulator models without PIE.

    config GPSP_LCD_DSI_DIAGNOSTICS
        bool "Log DSI frame timing summaries"
        depends on GPSP_LCD_DSI
        default n
        help
            Log frame counts and peak render/present times every 5 seconds.
            Sample one in 16 game frames and report phase timings every
            10 seconds, grouped by STAT on/off. Include PPA blend and
            text-cache update costs. Logging runs on the status worker.

    config GPSP_LCD_SPI_MHZ
        int "SPI clock (MHz)"
        depends on GPSP_LCD_SPI
        range 10 80
        default 40

    config GPSP_LCD_BGR
        bool "Use BGR color order"
        depends on GPSP_LCD
        default n

    config GPSP_LCD_INVERT_COLORS
        bool "Enable panel color inversion"
        depends on GPSP_LCD_SPI
        default y

    config GPSP_LCD_ROTATE_180
        bool "Rotate by 180 degrees"
        depends on GPSP_LCD
        default n

endmenu

menu "gpSP menu"

    config GPSP_MENU
        bool "In-game menu"
        depends on (GPSP_LCD || ESPEMU) && !GPSP_BENCHMARK
        default y
        help
            The pad's home button, or Select and Start together, pauses
            the game and opens a full-screen menu. ESP-EMU sends it to the
            host viewer.

endmenu

menu "gpSP serial input"
    depends on IDF_TARGET_ESP32P4 && !ESPEMU && ESP_CONSOLE_UART && !GPSP_BENCHMARK

    config GPSP_SERIAL_INPUT
        bool "Read buttons from the console UART"
        default y
        help
            Accept the host viewer's input messages on the console UART
            (espemu-host --serial). Buttons release after 0.5 seconds
            without a message.

endmenu

menu "gpSP USB gamepad"
    depends on IDF_TARGET_ESP32P4 && !ESPEMU && !GPSP_BENCHMARK

    config GPSP_USB_PAD
        bool "Read buttons from a USB gamepad"
        default n
        help
            Gamepad on the P4 Nano USB-A port: XInput (Xbox 360 class),
            Xbox One, Switch Pro Controller, DualShock 4 or DualSense,
            wired or through a 2.4 GHz dongle.

    config GPSP_USB_PAD_DIAGNOSTICS
        bool "Log USB gamepad health summaries"
        depends on GPSP_USB_PAD
        default n
        help
            Log report counts, report age, endpoint errors and client task
            delays every 5 seconds. Quiet devices are not treated as lost.

    config GPSP_USB_PAD_HID_DUMP
        bool "Log raw reports of other HID devices"
        depends on GPSP_USB_PAD
        default n
        help
            Open other HID devices and log each changed report, to work
            out a new pad's layout. Their buttons are not used. Sticks
            can flood the console UART, which serial input also uses.

endmenu

menu "gpSP status"
    depends on IDF_TARGET_ESP32P4 && !ESPEMU

    config GPSP_STATUS
        bool "Report CPU use, free memory and chip temperature"
        default y
        select FREERTOS_GENERATE_RUN_TIME_STATS
        select FREERTOS_USE_TRACE_FACILITY
        select FREERTOS_USE_STATS_FORMATTING_FUNCTIONS
        select FREERTOS_VTASKLIST_INCLUDE_COREID
        help
            Logs a STAT line every 2 seconds and shows the values in the
            LCD borders. The host viewer's F2 prints a per-task table.

endmenu

menu "gpSP cache"
    depends on IDF_TARGET_ESP32P4 && !ESPEMU

    config GPSP_DCACHE_AUTOLOAD
        bool "Prefetch PSRAM data into the L1 data cache"
        depends on SPIRAM
        default y
        help
            Enables L1 data cache autoload over PSRAM on cache misses
            and hits.

endmenu

menu "gpSP audio"
    depends on IDF_TARGET_ESP32P4 && !ESPEMU

    config GPSP_AUDIO
        bool "Play sound on the onboard speaker"
        default n
        help
            ES8311 DAC and board amplifier. The core makes sound at
            32,768 Hz and the I2S clock runs at the same rate, so samples
            only need a mono mix.

    config GPSP_AUDIO_VOLUME_DB
        int "DAC volume (dB)"
        depends on GPSP_AUDIO
        range -60 0
        default -6

    config GPSP_FRAMESKIP_AUTO
        bool "Skip drawing frames that fall behind"
        depends on GPSP_AUDIO && !GPSP_BENCHMARK
        default n
        help
            While the speaker queue runs low, the core emulates frames
            without drawing them, so game speed holds when frames take
            too long. At most 30 frames in a row are skipped. This is the
            default; "frameskip=" in gpsp.cfg overrides it.

    config GPSP_FRAMESKIP_THRESHOLD
        int "Skip below this speaker queue level (% of target)"
        depends on GPSP_AUDIO && !GPSP_BENCHMARK
        range 10 200
        default 50
        help
            Automatic frameskip starts when the speaker queue falls below
            this share of its 100 ms target. "frameskip_threshold=" in
            gpsp.cfg overrides it.

endmenu
```

## sdkconfig.defaults
```kconfig
CONFIG_ESPTOOLPY_FLASHSIZE_16MB=y
CONFIG_COMPILER_OPTIMIZATION_PERF=y
CONFIG_PARTITION_TABLE_CUSTOM=y
CONFIG_PARTITION_TABLE_CUSTOM_FILENAME="partitions_espemu.csv"
CONFIG_SPIRAM=y
CONFIG_SPIRAM_USE_MALLOC=y
CONFIG_SPIRAM_ALLOW_BSS_SEG_EXTERNAL_MEMORY=y
CONFIG_SPIRAM_XIP_FROM_PSRAM=y
CONFIG_ESP_MAIN_TASK_STACK_SIZE=16384
CONFIG_FREERTOS_HZ=1000
CONFIG_FATFS_VOLUME_COUNT=3
CONFIG_FATFS_API_ENCODING_UTF_8=y
CONFIG_FATFS_ALLOC_PREFER_EXTRAM=y
CONFIG_FATFS_ALLOC_PREFER_ALIGNED_WORK_BUFFERS=y
# CONFIG_GPSP_CARTRIDGE_AUTOSAVE is not set
# Browsers send long headers and URL-encoded paths.
CONFIG_HTTPD_MAX_REQ_HDR_LEN=1024
CONFIG_HTTPD_MAX_URI_LEN=1024
# Keep network buffers in PSRAM while a game is loaded.
CONFIG_SPIRAM_TRY_ALLOCATE_WIFI_LWIP=y
CONFIG_ESP_HOSTED_MEMPOOL_PREFER_SPIRAM=y
# CONFIG_ESP_SYSTEM_MEMPROT is not set
```
