## tests/p4-nano-audio-check/main/Kconfig.projbuild
```kconfig
# Copyright (C) 2026 Midworld Kim
# SPDX-License-Identifier: GPL-3.0-or-later

menu "P4 Nano audio check"

    choice AUDIO_TEST_OUTPUT
        prompt "I2S output sample rate"
        default AUDIO_TEST_OUTPUT_48000

        config AUDIO_TEST_OUTPUT_48000
            bool "48,000 Hz"

        config AUDIO_TEST_OUTPUT_32768
            bool "32,768 Hz"

    endchoice

    config AUDIO_TEST_OUTPUT_RATE
        int
        default 32768 if AUDIO_TEST_OUTPUT_32768
        default 48000

    config AUDIO_TEST_AMPLITUDE
        int "Peak test sample amplitude"
        range 256 8000
        default 3000

    config AUDIO_TEST_VOLUME_DB
        int "Default DAC volume (dB)"
        range -30 0
        default -12

    config AUDIO_TEST_LONG_SECONDS
        int "Seconds for the continuous playback test"
        range 10 120
        default 30

    config AUDIO_TEST_INJECT_STALL
        bool "Test an intentional 120 ms producer stall"
        default y
        help
            Expect a short gap during this stage. The test checks that
            buffer shortage is counted and playback recovers.

    config AUDIO_TEST_REPEAT
        bool "Repeat the full test sequence"
        default n

    config AUDIO_TEST_RECOVERY_ONLY
        bool "Run only the stall and recovery stages"
        depends on AUDIO_TEST_INJECT_STALL
        default n

endmenu
```

## tests/p4-nano-audio-check/sdkconfig.defaults
```kconfig
CONFIG_IDF_TARGET="esp32p4"
CONFIG_ESP32P4_REV_MIN_301=y
CONFIG_ESPTOOLPY_FLASHSIZE_16MB=y
CONFIG_ESP_DEFAULT_CPU_FREQ_MHZ_400=y
CONFIG_COMPILER_OPTIMIZATION_PERF=y
CONFIG_ESP_CONSOLE_UART_DEFAULT=y
CONFIG_ESP_MAIN_TASK_STACK_SIZE=8192
CONFIG_FREERTOS_HZ=1000
CONFIG_PARTITION_TABLE_CUSTOM=y
CONFIG_PARTITION_TABLE_CUSTOM_FILENAME="../../partitions_espemu.csv"
```

## tests/p4-nano-board-check/main/Kconfig.projbuild
```kconfig
# Copyright (C) 2026 Midworld Kim
# SPDX-License-Identifier: GPL-3.0-or-later

menu "P4 Nano board check"

    choice P4_NANO_BOARD
        prompt "Board"
        default P4_NANO_BOARD_NANO_WIFI6

        config P4_NANO_BOARD_NANO_WIFI6
            bool "ESP32-P4-NANO-WIFI6-DB (ESP32-C5 over SDIO)"

        config P4_NANO_BOARD_WT9932P4X_TINY
            bool "WT9932P4X-TINY (no radio)"
    endchoice

    config P4_NANO_SD_TEST
        bool "Run SD card speed test (FAT card with free space)"
        default y

    if P4_NANO_SD_TEST

    config P4_NANO_SD_TEST_MIB
        int "Test file size (MiB)"
        range 1 1024
        default 32

    config P4_NANO_SD_LDO_CHAN
        int "On-chip LDO channel for SD I/O power (-1 for none)"
        range -1 4
        default 4

    choice P4_NANO_SD_UHS
        prompt "UHS-I mode after DS and HS"
        default P4_NANO_SD_UHS_SDR104
        help
            The card stays at 1.8 V after a UHS-I run. Remove power before
            the next run.

        config P4_NANO_SD_UHS_NONE
            bool "None"

        config P4_NANO_SD_UHS_SDR50
            bool "SDR50 (100 MHz)"

        config P4_NANO_SD_UHS_DDR50
            bool "DDR50 (50 MHz)"

        config P4_NANO_SD_UHS_SDR104
            bool "SDR104 (200 MHz)"
    endchoice

    endif

    if P4_NANO_BOARD_NANO_WIFI6

    config P4_NANO_WIFI_SCAN
        bool "Run active Wi-Fi scan (requires attached antenna)"
        default n

    config P4_NANO_WIFI_SPEED_TEST
        bool "Connect to Wi-Fi and run iperf3 TCP throughput (requires antenna)"
        default n

    if P4_NANO_WIFI_SPEED_TEST

    config P4_NANO_WIFI_SSID
        string "Wi-Fi SSID"
        default ""

    config P4_NANO_WIFI_PASSWORD
        string "Wi-Fi password"
        default ""

    config P4_NANO_IPERF3_HOST
        string "iperf3 server IPv4 address"
        default ""

    config P4_NANO_IPERF3_PORT
        int "iperf3 server TCP port"
        range 1 65535
        default 5201

    config P4_NANO_IPERF3_SECONDS
        int "Seconds per direction"
        range 1 60
        default 10

    endif

    endif

endmenu
```

## tests/p4-nano-board-check/sdkconfig.defaults
```kconfig
CONFIG_IDF_TARGET="esp32p4"
CONFIG_ESP32P4_REV_MIN_300=y
CONFIG_ESPTOOLPY_FLASHSIZE_16MB=y
CONFIG_PARTITION_TABLE_CUSTOM=y
CONFIG_PARTITION_TABLE_CUSTOM_FILENAME="partitions.csv"
CONFIG_SPIRAM=y
CONFIG_SPIRAM_MODE_HEX=y
CONFIG_SPIRAM_SPEED_200M=y
CONFIG_SPIRAM_USE_MALLOC=y
CONFIG_SLAVE_IDF_TARGET_ESP32C5=y
CONFIG_ESP_HOSTED_SDIO_HOST_INTERFACE=y
CONFIG_ESP_HOSTED_SDIO_SLOT_1=y
CONFIG_ESP_HOSTED_SDIO_4_BIT_BUS=y
CONFIG_ESP_HOSTED_SDIO_CLOCK_FREQ_KHZ=40000
CONFIG_WIFI_RMT_DYNAMIC_TX_BUFFER_NUM=64
CONFIG_WIFI_RMT_TX_BA_WIN=32
CONFIG_WIFI_RMT_RX_BA_WIN=16
CONFIG_LWIP_TCP_SND_BUF_DEFAULT=41760
CONFIG_LWIP_TCP_WND_DEFAULT=65535
CONFIG_LWIP_TCP_RECVMBOX_SIZE=48
CONFIG_LWIP_UDP_RECVMBOX_SIZE=48
CONFIG_LWIP_TCPIP_RECVMBOX_SIZE=48
CONFIG_LWIP_TCP_SACK_OUT=y
CONFIG_ESP_HOSTED_PRIV_SDIO_PIN_CMD_SLOT_1=19
CONFIG_ESP_HOSTED_PRIV_SDIO_PIN_CLK_SLOT_1=18
CONFIG_ESP_HOSTED_PRIV_SDIO_PIN_D0_SLOT_1=14
CONFIG_ESP_HOSTED_PRIV_SDIO_PIN_D1_4BIT_BUS_SLOT_1=15
CONFIG_ESP_HOSTED_PRIV_SDIO_PIN_D2_4BIT_BUS_SLOT_1=16
CONFIG_ESP_HOSTED_PRIV_SDIO_PIN_D3_4BIT_BUS_SLOT_1=17
CONFIG_ESP_HOSTED_SDIO_GPIO_RESET_SLAVE=54
CONFIG_ESP_MAIN_TASK_STACK_SIZE=8192
CONFIG_FREERTOS_HZ=1000
CONFIG_COMPILER_OPTIMIZATION_PERF=y
```

## tests/p4-nano-dsi-check/main/Kconfig.projbuild
```kconfig
# Copyright (C) 2026 Midworld Kim
# SPDX-License-Identifier: GPL-3.0-or-later

rsource "../../../main/Kconfig.projbuild"

config DSI_CHECK_MODEL
    bool "Use test-only display and PPA model"
    default n
```

## tests/p4-nano-dsi-check/sdkconfig.defaults
```kconfig
CONFIG_IDF_TARGET="esp32p4"
CONFIG_ESP32P4_REV_MIN_301=y
CONFIG_ESPTOOLPY_FLASHSIZE_16MB=y
CONFIG_ESP_DEFAULT_CPU_FREQ_MHZ_400=y
CONFIG_COMPILER_OPTIMIZATION_PERF=y
CONFIG_ESP_CONSOLE_UART_DEFAULT=y
CONFIG_ESP_MAIN_TASK_STACK_SIZE=8192
CONFIG_FREERTOS_HZ=1000
CONFIG_SPIRAM=y
CONFIG_SPIRAM_SPEED_200M=y
CONFIG_SPIRAM_USE_MALLOC=y
# CONFIG_SPIRAM_MEMTEST is not set
CONFIG_GPSP_LCD=y
CONFIG_GPSP_LCD_DSI=y
CONFIG_GPSP_LCD_DSI_4_3=y
CONFIG_GPSP_MENU=y
# CONFIG_GPSP_STATUS is not set
# CONFIG_GPSP_AUDIO is not set
# CONFIG_GPSP_USB_PAD is not set
```

## tests/p4-nano-lcd-check/main/Kconfig.projbuild
```kconfig
# Copyright (C) 2026 Midworld Kim
# SPDX-License-Identifier: GPL-3.0-or-later

menu "P4 Nano LCD check"

    config LCD_TEST_SECONDS
        int "Seconds per SPI speed"
        range 5 60
        default 10

    config LCD_TEST_BGR
        bool "Use BGR color order"
        default n
        help
            Enable if the red and blue test bars are exchanged.

    config LCD_TEST_INVERT_COLORS
        bool "Enable panel color inversion"
        default y
        help
            Most ST7789 IPS panels require inversion. Disable if the
            test colors or the black border appear inverted.

    config LCD_TEST_ROTATE_180
        bool "Rotate landscape output by 180 degrees"
        default n

endmenu
```

## tests/p4-simd-smoke/sdkconfig.defaults
```kconfig
CONFIG_IDF_TARGET="esp32p4"
CONFIG_ESPTOOLPY_FLASHSIZE_16MB=y
# CONFIG_ESP_SYSTEM_MEMPROT is not set
CONFIG_ESP_TIMER_SUPPORTS_ISR_DISPATCH_METHOD=y
CONFIG_SPIRAM=y
CONFIG_SPIRAM_MODE_HEX=y
CONFIG_SPIRAM_SPEED_200M=y
CONFIG_SPIRAM_USE_CAPS_ALLOC=y
CONFIG_CACHE_L2_CACHE_128KB=y
CONFIG_CACHE_L2_CACHE_LINE_64B=y
```

## tests/rv32-arm-mul/sdkconfig.defaults
```kconfig
CONFIG_IDF_TARGET="esp32p4"
CONFIG_ESPTOOLPY_FLASHSIZE_16MB=y
CONFIG_SPIRAM=y
# CONFIG_ESP_SYSTEM_MEMPROT is not set
CONFIG_SPIRAM_MODE_HEX=y
CONFIG_SPIRAM_SPEED_200M=y
```

## tests/rv32-ram-smc/sdkconfig.defaults
```kconfig
CONFIG_IDF_TARGET="esp32p4"
CONFIG_ESPTOOLPY_FLASHSIZE_16MB=y
CONFIG_SPIRAM=y
CONFIG_SPIRAM_USE_MALLOC=y
CONFIG_SPIRAM_ALLOW_BSS_SEG_EXTERNAL_MEMORY=y
# CONFIG_ESP_SYSTEM_MEMPROT is not set
CONFIG_GPSP_RV32_ROM_CACHE_KIB=1024
CONFIG_GPSP_BENCHMARK=y
CONFIG_ESPEMU=y
CONFIG_GPSP_BENCHMARK_FRAMES=160
CONFIG_GPSP_BENCHMARK_STOP_AFTER_REPORT=y
```

## tests/rv32-thumb-ram-helper/sdkconfig.defaults
```kconfig
CONFIG_IDF_TARGET="esp32p4"
CONFIG_ESPTOOLPY_FLASHSIZE_16MB=y
CONFIG_SPIRAM=y
CONFIG_SPIRAM_USE_MALLOC=y
CONFIG_SPIRAM_ALLOW_BSS_SEG_EXTERNAL_MEMORY=y
# CONFIG_ESP_SYSTEM_MEMPROT is not set
```

## tests/usb-bt-hci/sdkconfig.defaults
```kconfig
CONFIG_IDF_TARGET="esp32p4"
CONFIG_ESP32P4_REV_MIN_301=y
CONFIG_ESPTOOLPY_FLASHSIZE_16MB=y
CONFIG_ESP_DEFAULT_CPU_FREQ_MHZ_400=y
CONFIG_COMPILER_OPTIMIZATION_PERF=y
CONFIG_ESP_MAIN_TASK_STACK_SIZE=8192
CONFIG_FREERTOS_HZ=1000
CONFIG_SPIRAM=y
CONFIG_SPIRAM_SPEED_200M=y
CONFIG_SPIRAM_USE_MALLOC=y
# CONFIG_SPIRAM_MEMTEST is not set
CONFIG_GPSP_USB_PAD=y
CONFIG_GPSP_USB_BT=y
# CONFIG_GPSP_AUDIO is not set
# CONFIG_GPSP_STATUS is not set
CONFIG_BT_BLUEDROID_PINNED_TO_CORE_1=y
# CONFIG_BT_BLUEDROID_ESP_COEX_VSC is not set
CONFIG_BT_ENC_KEY_SIZE_CTRL_NONE=y
# CONFIG_BT_BLE_ENABLED is not set
```
